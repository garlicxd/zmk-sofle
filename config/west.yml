## config/west.yml
```yaml
manifest:
  remotes:
    - name: zmkfirmware
      url-base: https://github.com/zmkfirmware
      # Additional modules containing boards/shields/custom code can be listed here as well.
      # See:
      # - https://zmk.dev/docs/features/modules
      # - https://docs.zephyrproject.org/3.5.0/develop/west/manifest.html#projects
    - name: gpeye
      url-base: https://github.com/GPeye
    - name: urob
      url-base: https://github.com/urob
    - name: theol0403
      url-base: https://github.com/theol0403

  projects:
    - name: mario-peripheral-animation
      remote: gpeye
      revision: main 
    - name: zmk
      remote: zmkfirmware
      revision: main
      import: app/west.yml

    - name: zmk-helpers
      remote: urob
      revision: main
    - name: zmk-auto-layer
      remote: urob
      revision: main
    - name: zmk-leader-key
      remote: urob
      revision: main
    - name: zmk-adaptive-key
      remote: urob
      revision: main
    - name: zmk-tri-state
      remote: urob
      revision: main

    # Apply patch to fix child nodes issue
    - name: zephyr
      remote: urob
      revision: v3.5.0+zmk-fixes
      clone-depth: 1
      import:
        name-blocklist:
          - ci-tools
          - hal_altera
          - hal_cypress
          - hal_infineon
          - hal_microchip
          - hal_nxp
          - hal_openisa
          - hal_silabs
          - hal_xtensa
          - hal_st
          - hal_ti
          - loramac-node
          - mcuboot
          - mcumgr
          - net-tools
          - openthread
          - edtt
          - trusted-firmware-m
    
    # ZMK modules

  self:
    path: config
```
