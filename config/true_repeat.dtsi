// add it to adaptive key with -> repeat {TRUE_REPEAT};
// or create a true repeat using 

#define TRUE_REPEAT \
/* Default behavior for alphanumeric keys */ \
    bindings = <&key_repeat>; trigger-keys = <LEFT_CHARS RIGHT_CHARS>; max-prior-idle-ms = <ADAPTIVE_RESET>;}; \
 \
/* --- Left Hand Symbols --- */ \
    repeat_slash {bindings = <&kp SLASH>; trigger-keys = <SLASH>; max-prior-idle-ms = <ADAPTIVE_RESET>;}; \
    repeat_backslash {bindings = <&kp BACKSLASH>; trigger-keys = <BACKSLASH>; max-prior-idle-ms = <ADAPTIVE_RESET>;}; \
    repeat_minus {bindings = <&kp MINUS>; trigger-keys = <MINUS>; max-prior-idle-ms = <ADAPTIVE_RESET>;}; \
    repeat_underscore {bindings = <&kp UNDERSCORE>; trigger-keys = <UNDERSCORE>; max-prior-idle-ms = <ADAPTIVE_RESET>;}; \
    repeat_comma {bindings = <&kp COMMA>; trigger-keys = <COMMA>; max-prior-idle-ms = <ADAPTIVE_RESET>;}; \
    repeat_asterisk {bindings = <&kp ASTERISK>; trigger-keys = <ASTERISK>; max-prior-idle-ms = <ADAPTIVE_RESET>;}; \
    repeat_dot {bindings = <&kp DOT>; trigger-keys = <DOT>; max-prior-idle-ms = <ADAPTIVE_RESET>;}; \
    repeat_double_quotes {bindings = <&kp DOUBLE_QUOTES>; trigger-keys = <DOUBLE_QUOTES>; max-prior-idle-ms = <ADAPTIVE_RESET>;}; \
    repeat_caret {bindings = <&kp CARET>; trigger-keys = <CARET>; max-prior-idle-ms = <ADAPTIVE_RESET>;}; \
    repeat_dollar {bindings = <&kp DOLLAR>; trigger-keys = <DOLLAR>; max-prior-idle-ms = <ADAPTIVE_RESET>;}; \
    repeat_ampersand {bindings = <&kp AMPERSAND>; trigger-keys = <AMPERSAND>; max-prior-idle-ms = <ADAPTIVE_RESET>;}; \
    repeat_semicolon {bindings = <&kp SEMICOLON>; trigger-keys = <SEMICOLON>; max-prior-idle-ms = <ADAPTIVE_RESET>;}; \
    repeat_hash {bindings = <&kp HASH>; trigger-keys = <HASH>; max-prior-idle-ms = <ADAPTIVE_RESET>;}; \
    repeat_at_sign {bindings = <&kp AT_SIGN>; trigger-keys = <AT_SIGN>; max-prior-idle-ms = <ADAPTIVE_RESET>;}; \
    repeat_question {bindings = <&kp QUESTION>; trigger-keys = <QUESTION>; max-prior-idle-ms = <ADAPTIVE_RESET>;}; \
    repeat_pipe {bindings = <&kp PIPE>; trigger-keys = <PIPE>; max-prior-idle-ms = <ADAPTIVE_RESET>;}; \
    repeat_exclamation {bindings = <&kp EXCLAMATION>; trigger-keys = <EXCLAMATION>; max-prior-idle-ms = <ADAPTIVE_RESET>;}; \
    repeat_percent {bindings = <&kp PERCENT>; trigger-keys = <PERCENT>; max-prior-idle-ms = <ADAPTIVE_RESET>;}; \
    repeat_equal {bindings = <&kp EQUAL>; trigger-keys = <EQUAL>; max-prior-idle-ms = <ADAPTIVE_RESET>;}; \
    repeat_escape {bindings = <&kp ESCAPE>; trigger-keys = <ESCAPE>; max-prior-idle-ms = <ADAPTIVE_RESET>;}; \
 \
/* --- Right Hand Symbols --- */ \
    repeat_tilde {bindings = <&kp TILDE>; trigger-keys = <TILDE>; max-prior-idle-ms = <ADAPTIVE_RESET>;}; \
    repeat_colon {bindings = <&kp COLON>; trigger-keys = <COLON>; max-prior-idle-ms = <ADAPTIVE_RESET>;}; \
    repeat_left_bracket {bindings = <&kp LEFT_BRACKET>; trigger-keys = <LEFT_BRACKET>; max-prior-idle-ms = <ADAPTIVE_RESET>;}; \
    repeat_less_than {bindings = <&kp LESS_THAN>; trigger-keys = <LESS_THAN>; max-prior-idle-ms = <ADAPTIVE_RESET>;}; \
    repeat_single_quote {bindings = <&kp SINGLE_QUOTE>; trigger-keys = <SINGLE_QUOTE>; max-prior-idle-ms = <ADAPTIVE_RESET>;}; \
    repeat_grave {bindings = <&kp GRAVE>; trigger-keys = <GRAVE>; max-prior-idle-ms = <ADAPTIVE_RESET>;}; \
    repeat_plus {bindings = <&kp PLUS>; trigger-keys = <PLUS>; max-prior-idle-ms = <ADAPTIVE_RESET>;}; \
    repeat_left_parenthesis {bindings = <&kp LEFT_PARENTHESIS>; trigger-keys = <LEFT_PARENTHESIS>; max-prior-idle-ms = <ADAPTIVE_RESET>;}; \
    repeat_left_brace {bindings = <&kp LEFT_BRACE>; trigger-keys = <LEFT_BRACE>; max-prior-idle-ms = <ADAPTIVE_RESET>;}; \
    repeat_right_bracket {bindings = <&kp RIGHT_BRACKET>; trigger-keys = <RIGHT_BRACKET>; max-prior-idle-ms = <ADAPTIVE_RESET>;}; \
    repeat_greater_than {bindings = <&kp GREATER_THAN>; trigger-keys = <GREATER_THAN>; max-prior-idle-ms = <ADAPTIVE_RESET>;}; \
    repeat_right_parenthesis {bindings = <&kp RIGHT_PARENTHESIS>; trigger-keys = <RIGHT_PARENTHESIS>; max-prior-idle-ms = <ADAPTIVE_RESET>;}; \
    repeat_right_brace {bindings = <&kp RIGHT_BRACE>; trigger-keys = <RIGHT_BRACE>; max-prior-idle-ms = <ADAPTIVE_RESET>;}; \
 \
/* --- Numbers --- */ \
    repeat_n0 {bindings = <&kp N0>; trigger-keys = <N0>; max-prior-idle-ms = <ADAPTIVE_RESET>;}; \
    repeat_n1 {bindings = <&kp N1>; trigger-keys = <N1>; max-prior-idle-ms = <ADAPTIVE_RESET>;}; \
    repeat_n2 {bindings = <&kp N2>; trigger-keys = <N2>; max-prior-idle-ms = <ADAPTIVE_RESET>;}; \
    repeat_n3 {bindings = <&kp N3>; trigger-keys = <N3>; max-prior-idle-ms = <ADAPTIVE_RESET>;}; \
    repeat_n4 {bindings = <&kp N4>; trigger-keys = <N4>; max-prior-idle-ms = <ADAPTIVE_RESET>;}; \
    repeat_n5 {bindings = <&kp N5>; trigger-keys = <N5>; max-prior-idle-ms = <ADAPTIVE_RESET>;}; \
    repeat_n6 {bindings = <&kp N6>; trigger-keys = <N6>; max-prior-idle-ms = <ADAPTIVE_RESET>;}; \
    repeat_n7 {bindings = <&kp N7>; trigger-keys = <N7>; max-prior-idle-ms = <ADAPTIVE_RESET>;}; \
    repeat_n8 {bindings = <&kp N8>; trigger-keys = <N8>; max-prior-idle-ms = <ADAPTIVE_RESET>;}; \
    repeat_n9 {bindings = <&kp N9>; trigger-keys = <N9>; max-prior-idle-ms = <ADAPTIVE_RESET>;

#define TRUE_KEY_REPEAT(NAME, BINDING) \
    ZMK_ADAPTIVE_KEY(NAME, bindings = <BINDING>; repeat {TRUE_REPEAT};)