#include <input/processors.dtsi>
#include <dt-bindings/zmk/pointing.h>
#include <zephyr/dt-bindings/input/input-event-codes.h>

#define ZMK_POINTING_DEFAULT_MOVE_VAL 1200  // 600
#define ZMK_POINTING_DEFAULT_SCRL_VAL 25   // 10

&mmv_input_listener { input-processors = <&zip_xy_scaler 2 1>; };

&msc_input_listener { input-processors = <&zip_scroll_scaler 2 1>; };

&msc {
    acceleration-exponent = <1>;      // 0
    time-to-max-speed-ms = <100>;       // 300
    delay-ms = <0>;                   // 0
};

&mmv {
    time-to-max-speed-ms = <500>;
    acceleration-exponent = <1>;
    trigger-period-ms = <16>;
};

#define MS_U &mmv MOVE_UP
#define MS_D &mmv MOVE_DOWN
#define MS_L &mmv MOVE_LEFT
#define MS_R &mmv MOVE_RIGHT
#define WH_U &msc SCRL_UP
#define WH_D &msc SCRL_DOWN
#define WH_L &msc SCRL_LEFT
#define WH_R &msc SCRL_RIGHT